## Kconfig
```kconfig
mainmenu "C/CPP CMake project framework Kconfig configuration"

menu "Toolchain configuration"
	config TOOLCHAIN_PATH
		string "toolchain path"
		default ""

	config TOOLCHAIN_PREFIX
		string "toolchain prefix"
		default ""

	config TOOLCHAIN_SYSTEM
		string "toolchain system"
		default "linux"
		help
			linux or win
endmenu

menu "Components configuration"
	osource "${SDK_PATH}/components/*/Kconfig"
	osource "${PROJECT_PATH}/../components/*/Kconfig"
	osource "${PROJECT_PATH}/*/Kconfig"
endmenu

config USE_STRIP_REDUCE_SIZE_ENABLED
	bool "strip reduce size"
	default n
```

## components/HAL_Driver_Libs/Kconfig
```kconfig
menuconfig HAL_DRIVER_LIBS_COMPONENT_ENABLED
    bool "Enable HAL_Driver_Libs"
    default n

    config HAL_DRIVER_LIBS_OLED_ENABLED
        bool "compile oled lib"
        default n
        depends on HAL_DRIVER_LIBS_COMPONENT_ENABLED





    config HAL_DRIVER_LIBS_COMPONENT_DYNAMIC
        bool "compile component as dynamic(shared) lib"
        default n
        depends on HAL_DRIVER_LIBS_COMPONENT_ENABLED
```

## components/at_bsp/Kconfig
```kconfig
menuconfig AT32_BSP_ENABLED
    bool "Enable at32_bsp support"
    default n
    help
        enable at32 bsp support

    choice
        prompt "choice board"
        default AT32F415_BSP_ENABLED
        depends on AT32_BSP_ENABLED
    config AT32F415_BSP_ENABLED
        bool "enable at32f415 bsp"
        help
            build by AT32!
    endchoice
```

## components/ax_common_hal/Kconfig
```kconfig
menuconfig AX_COMMON_HAL_ENABLED
    bool "Enable ax_common_hal support"
    default n
    help
        enable axera ax_common_hal support
```

## components/ax_msp/Kconfig
```kconfig
menuconfig AX_MSP_ENABLED
    bool "Enable ax_msp support"
    default n
    help
        enable axera bsp support

    choice
        prompt "choice board"
        default AX_620E_MSP_ENABLED
        depends on AX_MSP_ENABLED
    config AX_620E_MSP_ENABLED
        bool "enable ax620e bsp"
        help
            build by AXERA!
    config AX_520_MSP_ENABLED
        bool "enable ax520 bsp"
        help
            build by AXERA!
    endchoice

    config SAMPLE_COMMON_ENABLED
        bool "Enable sample common"
        default n
        depends on AX_MSP_ENABLED
        help
            enable sample common
```

## components/d_hal_api/Kconfig
```kconfig
menuconfig D_HAL_ENABLED
    bool "Enable d_hal_api support"
    default n
    help
        enable d_hal_api support
    
    config D_HAL_LOCAL_ENABLED
        bool "Enable d_hal_local"
        default n
        depends on D_HAL_ENABLED
        help
            enable d_hal_local common
```

## components/dtc_component/Kconfig
```kconfig
menuconfig DTC_COMPONENT_ENABLED
    bool "Enable dtc & libfdt"
    default n

    config DTS_AUTO_CONFIG_COMMON_ENABLED
        bool "Enable dts auto config common"
        default n
        depends on DTC_COMPONENT_ENABLED
        help
            enable dts auto config common
```

## components/ev/Kconfig
```kconfig
menuconfig LEV_ENABLED
    bool "Enable lev"
    default n

	config LEV_WITH_OPENSSL
		bool "with openssl library"
		default n
		depends on LEV_ENABLED

    config LEV_DYNAMIC
        bool "compile component as dynamic(shared) lib"
        default n
        depends on LEV_ENABLED
```

## components/ffi/Kconfig
```kconfig
menuconfig LFFI_ENABLED
    bool "Enable lffi"
    default n

    config LFFI_DYNAMIC
        bool "compile component as dynamic(shared) lib"
        default n
        depends on LFFI_ENABLED
```

## components/framework-portduino/Kconfig
```kconfig
menuconfig PORTDUINO_ENABLED
    bool "framework-portduino configuration"
    default n
```

## components/lua_component/Kconfig
```kconfig
menuconfig LUA_COMPONENT_ENABLED
    bool "Enable lua"
    default n

    config LUA_FFI
        bool "compile with ffi"
        default n
        depends on LUA_COMPONENT_ENABLED && LFFI_DYNAMIC

    config LUA_COMPONENT_ELF
        bool "compile lua and luac"
        default n
        depends on LUA_COMPONENT_ENABLED

    config LUA_COMPONENT_DYNAMIC
        bool "compile component as dynamic(shared) lib"
        default n
        depends on LUA_COMPONENT_ENABLED
```

## components/single_header_libs/Kconfig
```kconfig
menuconfig SINGLE_HEADER_LIBS_ENABLED
    bool "Enable nanojpeg"
    default n

    config SINGLE_HEADER_LIBS_DYNAMIC
        bool "compile component as dynamic(shared) lib"
        default n
        depends on SINGLE_HEADER_LIBS_ENABLED
```

## components/stm32_bsp/Kconfig
```kconfig
menuconfig STM32_BSP_ENABLED
    bool "Enable stm32 bsp support"
    default n
    help
        enable stm32 bsp support

    choice
        prompt "choice board"
        default STM32G431_BSP_ENABLED
        depends on STM32_BSP_ENABLED
    config STM32G431_BSP_ENABLED
        bool "enable stm32g431 bsp"
        help
            build by STM32!
    endchoice
```

## components/tbox/Kconfig
```kconfig
menuconfig TBOX_ENABLED
    bool "Enable tbox"
    default n

    config TBOX_DYNAMIC
        bool "compile component as dynamic(shared) lib"
        default n
        depends on TBOX_ENABLED
```

## components/utilities/Kconfig
```kconfig
menuconfig UTILITIES_ENABLED
    bool "Enable threerDparty"
    default n


    config UTILITIES_FMT_ENABLED
        bool "compile fmt lib"
        default n
        depends on UTILITIES_ENABLED


    config UTILITIES_EASYMSGCPP_ENABLED
        bool "compile easy-msg-cpp lib"
        default n
        depends on UTILITIES_ENABLED


    config UTILITIES_BASE64_ENABLED
        bool "compile base64 lib"
        default n
        depends on UTILITIES_ENABLED

    config UTILITIES_UART_ENABLED
        bool "compile uart lib"
        default n
        depends on UTILITIES_ENABLED

    config UTILITIES_I2C_ENABLED
        bool "compile i2c lib"
        default n
        depends on UTILITIES_ENABLED

    config UTILITIES_SPI_ENABLED
        bool "compile spi lib"
        default n
        depends on UTILITIES_ENABLED

    config UTILITIES_SIMPILE_DRAW_ENABLED
        bool "compile simple_draw lib"
        default n
        depends on UTILITIES_ENABLED

    config UTILITIES_FRAMEBUFFER_ENABLED
        bool "compile framebuffer lib"
        default n
        depends on UTILITIES_ENABLED

    config UTILITIES_INI_ENABLED
        bool "compile ini lib"
        default n
        depends on UTILITIES_ENABLED

    config UTILITIES_PTMX_ENABLED
        bool "compile ptmx lib"
        default n
        depends on UTILITIES_ENABLED

    config UTILITIES_DYNAMIC
        bool "compile threerDparty as dynamic(shared) lib"
        default n
        depends on UTILITIES_ENABLED
```
